/ {
    // ============================================================
    // Dead‑key definitions (internal state flags)
    // ============================================================
    #define DK_CAP      F21   // Capitalize next letter

    // ============================================================
    // Macro to generate adaptive letter behaviors
    //
    // Usage:
    //   ADAPTIVE_CAP_LETTER(A)
    //   ADAPTIVE_CAP_LETTER(B)
    //   ...
    //
    // Expands into a full adaptive‑key behavior for that letter.
    // ============================================================
    #define ADAPTIVE_CAP_LETTER(L) \
    ak_##L: ak_##L { \
        compatible = "zmk,behavior-adaptive-key"; \
        #binding-cells = <0>; \
        bindings = <&kp L>; \
        dead-keys = <DK_CAP>; \
        cap { \
            trigger-keys = <DK_CAP>; \
            bindings = <&kp LS(L)>; \
        }; \
    };

    behaviors {

        // ============================================================
        // SMART SPACE KEY
        // ============================================================
        ak_space: ak_space {
            compatible = "zmk,behavior-adaptive-key";
            #binding-cells = <0>;
            bindings = <&kp SPACE>;   // Default: normal space
            dead-keys = <DK_CAP>;

            // 1. Punctuation → SPACE → set capitalization + mark dot-space state
            cap_trigger {
                trigger-keys = <DOT EXCLAMATION QUESTION>;
                max-prior-idle-ms = <400>;
                bindings = <&kp SPACE &kp DK_CAP>;
            };

            // 2. DK_CAP → SPACE → cancel capitalization, output nothing
            cancel_cap {
                trigger-keys = <DK_CAP>;
                max-prior-idle-ms = <400>;
                bindings = <&none>;
            };
        };

        // ============================================================
        // EXPAND MACRO FOR ALL LETTERS A–Z
        // ============================================================
        ADAPTIVE_CAP_LETTER(A)
        ADAPTIVE_CAP_LETTER(B)
        ADAPTIVE_CAP_LETTER(C)
        ADAPTIVE_CAP_LETTER(D)
        ADAPTIVE_CAP_LETTER(E)
        ADAPTIVE_CAP_LETTER(F)
        ADAPTIVE_CAP_LETTER(G)
        ADAPTIVE_CAP_LETTER(H)
        ADAPTIVE_CAP_LETTER(I)
        ADAPTIVE_CAP_LETTER(J)
        ADAPTIVE_CAP_LETTER(K)
        ADAPTIVE_CAP_LETTER(L)
        ADAPTIVE_CAP_LETTER(M)
        ADAPTIVE_CAP_LETTER(N)
        ADAPTIVE_CAP_LETTER(O)
        ADAPTIVE_CAP_LETTER(P)
        ADAPTIVE_CAP_LETTER(Q)
        ADAPTIVE_CAP_LETTER(R)
        ADAPTIVE_CAP_LETTER(S)
        ADAPTIVE_CAP_LETTER(T)
        ADAPTIVE_CAP_LETTER(U)
        ADAPTIVE_CAP_LETTER(V)
        ADAPTIVE_CAP_LETTER(W)
        ADAPTIVE_CAP_LETTER(X)
        ADAPTIVE_CAP_LETTER(Y)
        ADAPTIVE_CAP_LETTER(Z)
    };
};